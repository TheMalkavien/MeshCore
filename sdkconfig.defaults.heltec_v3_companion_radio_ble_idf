## sdkconfig.defaults.heltec_v3_companion_radio_ble_idf
```kconfig
CONFIG_AUTOSTART_ARDUINO=y
CONFIG_FREERTOS_HZ=1000

CONFIG_ESPTOOLPY_FLASHSIZE_8MB=y

CONFIG_PM_ENABLE=y
CONFIG_FREERTOS_USE_TICKLESS_IDLE=y
CONFIG_PM_DFS_INIT_AUTO=y

# Keep console on UART only; USB console path is unnecessary for companion BLE.
CONFIG_ESP_CONSOLE_UART_DEFAULT=y
CONFIG_ESP_CONSOLE_SECONDARY_NONE=y
# CONFIG_ESP_CONSOLE_SECONDARY_USB_SERIAL_JTAG is not set
# CONFIG_ESP_PHY_ENABLE_USB is not set
# CONFIG_RTC_CLOCK_BBPLL_POWER_ON_WITH_USB is not set

CONFIG_BT_ENABLED=y
CONFIG_BT_BLUEDROID_ENABLED=y
CONFIG_BT_BLE_ENABLED=y
CONFIG_BT_BLE_42_FEATURES_SUPPORTED=y
CONFIG_BT_GATTS_ENABLE=y
CONFIG_BT_GATTC_ENABLE=y
CONFIG_BT_CTRL_MODEM_SLEEP=y
CONFIG_BT_CTRL_MAIN_XTAL_PU_DURING_LIGHT_SLEEP=y
```

## variants/heltec_v3/sdkconfig.defaults.heltec_v3_companion_radio_ble_idf
```kconfig
CONFIG_FREERTOS_HZ=1000
CONFIG_AUTOSTART_ARDUINO=y

# Keep boot noise and console traffic disabled for low-power firmware.
CONFIG_BOOTLOADER_LOG_LEVEL_NONE=y
CONFIG_BOOTLOADER_LOG_LEVEL=0
CONFIG_BOOT_ROM_LOG_ALWAYS_OFF=y

# Low-power baseline: lower default CPU frequency at boot.
CONFIG_ESP32S3_DEFAULT_CPU_FREQ_80=y
CONFIG_ESP32S3_DEFAULT_CPU_FREQ_MHZ=80

# Enable automatic power management + DFS + automatic light sleep.
CONFIG_PM_ENABLE=y
CONFIG_PM_DFS_INIT_AUTO=y
CONFIG_FREERTOS_USE_TICKLESS_IDLE=y
# 4 ticks at 1000 Hz ~= 4 ms idle before entering light sleep.
# More aggressive sleep entry to reduce idle consumption.
CONFIG_FREERTOS_IDLE_TIME_BEFORE_SLEEP=4
# NOTE:
# On ESP32-S3, ESP-IDF enables ESP_SLEEP_GPIO_RESET_WORKAROUND by default,
# which selects PM_SLP_DISABLE_GPIO when tickless idle is active.
# We keep that safety workaround and exempt required pins in code
# (see RefCountedDigitalPin::begin()).

# BLE controller low-power features (strict profile with reliable advertising).
CONFIG_BT_CTRL_MODEM_SLEEP=y
CONFIG_BT_CTRL_MODEM_SLEEP_MODE_1=y
CONFIG_BT_CTRL_LPCLK_SEL_MAIN_XTAL=y
CONFIG_BT_CTRL_MAIN_XTAL_PU_DURING_LIGHT_SLEEP=y
CONFIG_BT_CTRL_BLE_MAX_ACT=3

# Keep reduced BLE TX power but not ultra-low, to preserve discoverability.
CONFIG_BT_CTRL_DFT_TX_POWER_LEVEL_P3=y

# Minimize logging overhead in strict mode.
CONFIG_LOG_DEFAULT_LEVEL_NONE=y
CONFIG_LOG_DEFAULT_LEVEL=0
CONFIG_ARDUHAL_LOG_DEFAULT_LEVEL_NONE=y
CONFIG_ARDUHAL_LOG_DEFAULT_LEVEL=0
CONFIG_BT_STACK_NO_LOG=y

CONFIG_BT_ENABLED=y
CONFIG_BT_BLE_ENABLED=y
CONFIG_BT_BLUEDROID_ENABLED=y
CONFIG_BT_BLE_42_FEATURES_SUPPORTED=y
CONFIG_BTDM_CTRL_MODE_BLE_ONLY=y
CONFIG_BTDM_CTRL_MODE_BR_EDR_ONLY=n
CONFIG_BTDM_CTRL_MODE_BTDM=n
CONFIG_ESP_CONSOLE_NONE=y
CONFIG_ESP_CONSOLE_SECONDARY_NONE=y
CONFIG_ESP_PHY_ENABLE_USB=n
CONFIG_ESPTOOLPY_FLASHSIZE_8MB=y
CONFIG_ESPTOOLPY_FLASHSIZE="8MB"
CONFIG_ESPTOOLPY_FLASHSIZE_DETECT=n

# Keep Task WDT enabled but avoid false positives on Arduino loopTask pinned to CPU1.
CONFIG_ESP_TASK_WDT=y
CONFIG_ESP_TASK_WDT_TIMEOUT_S=20
CONFIG_ESP_TASK_WDT_CHECK_IDLE_TASK_CPU0=y
CONFIG_ESP_TASK_WDT_CHECK_IDLE_TASK_CPU1=n
```

## variants/heltec_v4/sdkconfig.defaults.heltec_v4_companion_radio_ble_idf
```kconfig
CONFIG_FREERTOS_HZ=1000
CONFIG_AUTOSTART_ARDUINO=y
CONFIG_BT_ENABLED=y
CONFIG_BT_BLE_ENABLED=y
CONFIG_BT_BLUEDROID_ENABLED=y
CONFIG_BT_BLE_42_FEATURES_SUPPORTED=y
CONFIG_BTDM_CTRL_MODE_BLE_ONLY=y
CONFIG_BTDM_CTRL_MODE_BR_EDR_ONLY=n
CONFIG_BTDM_CTRL_MODE_BTDM=n
CONFIG_ESPTOOLPY_FLASHSIZE_16MB=y
CONFIG_ESPTOOLPY_FLASHSIZE="16MB"
CONFIG_ESPTOOLPY_FLASHSIZE_DETECT=n

# Keep Task WDT enabled but avoid false positives on Arduino loopTask pinned to CPU1.
CONFIG_ESP_TASK_WDT=y
CONFIG_ESP_TASK_WDT_TIMEOUT_S=20
CONFIG_ESP_TASK_WDT_CHECK_IDLE_TASK_CPU0=y
CONFIG_ESP_TASK_WDT_CHECK_IDLE_TASK_CPU1=n

# Backward-compatible aliases used by some ESP-IDF/Arduino combinations.
CONFIG_TASK_WDT=y
CONFIG_TASK_WDT_TIMEOUT_S=20
CONFIG_TASK_WDT_CHECK_IDLE_TASK_CPU0=y
CONFIG_TASK_WDT_CHECK_IDLE_TASK_CPU1=n
```
